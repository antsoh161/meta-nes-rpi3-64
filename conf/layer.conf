## conf/layer.conf
```bitbake
# We have a conf and classes directory, add to BBPATH
BBPATH .= ":${LAYERDIR}"

# We have recipes-* directories, add to BBFILES
BBFILES += "${LAYERDIR}/recipes-*/*/*.bb \
            ${LAYERDIR}/recipes-*/*/*.bbappend"

BBFILE_COLLECTIONS += "meta-nes-rpi"
BBFILE_PATTERN_meta-nes-rpi = "^${LAYERDIR}/"
BBFILE_PRIORITY_meta-nes-rpi = "6"

LAYERDEPENDS_meta-nes-rpi = "core"
LAYERSERIES_COMPAT_meta-nes-rpi = "dunfell"
```
